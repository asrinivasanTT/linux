// SPDX-License-Identifier: (GPL-2.0 OR MIT)
/dts-v1/;

#include "blackhole.dtsi"

/ {
	model = "Tenstorrent Blackhole P100";
	compatible = "tenstorrent,blackhole-p100", "tenstorrent,blackhole";

	chosen {
		bootargs = "rw console=hvc0 earlycon=sbi panic=-1 initrd=0x4000e5000000,2097152";
	};
};
